## arch/arm64/realme/Kconfig
```kconfig
menu "Realme product selection"

config PRODUCT_REALME
	bool "Realme devices"
	help
	  This enables support for Realme devices.

if PRODUCT_REALME

config PRODUCT_REALME_SDM710
	bool "Realme SDM710-Common"

choice
	prompt "Realme device"

config PRODUCT_REALME_RMX1901
	bool "Realme X"
	select PRODUCT_REALME_SDM710
	help
	  This enables support for Realme X.

endchoice

endif

endmenu
```

## drivers/input/touchscreen/oppo_touchscreen/Synaptics/S3706/Kconfig
```kconfig
if PRODUCT_REALME_RMX1901

config TOUCHPANEL_SYNAPTICS_S3706
	bool "TP Synaptics_S3508 IC enable or not for OPPO"
	---help---
	say Y to enable driver for Touchpanel useing synaptics s3706
	say Y to enable driver for Touchpanel useing synaptics s3706
	
endif
```

## drivers/soc/oppo/Kconfig
```kconfig
# ifdef CONFIG_PRODUCT_REALME_SDM710
# yixue.ge add for config oppo software common soft
config OPPO_ARCH_FILE
	bool "for build directory oppo"
	---help---
	say Y to buid in

config OPPO_COMMON_SOFT
      bool "config oppo common software"
	  select OPPO_ARCH_FILE
	  help
		define this config to get project verion from sharemem.
		Maybe this value is from CDT or dynamic identify by hardware
		id.

config OPPO_DEVICE_IFNO
      bool "config oppo devinfo"
	  select OPPO_ARCH_FILE
	  help
		define this config to compile devinfo.c for device register
		.
source "drivers/soc/oppo/oppo_project/Kconfig"

source "drivers/soc/oppo/oppo_devinfo/Kconfig"

source "drivers/soc/oppo/oppo_trace/Kconfig"
source "drivers/soc/oppo/oppo_mdmrst/Kconfig"

source "drivers/soc/oppo/oppo_hypnus/Kconfig"

#ifdef CONFIG_PRODUCT_REALME_SDM710
#//John.Xu@PhoneSw.AudioDriver, 2016/02/22, Add for critical_log
#source "drivers/soc/oppo/oppo_criticallog/Kconfig"
#endif /* CONFIG_PRODUCT_REALME_SDM710 */

#ifdef CONFIG_PRODUCT_REALME_SDM710
#//wenbin.liu@PSW.Kernel.MM, 2018/05/23, Add for Healthinfo monitor
source "drivers/soc/oppo/oppo_healthinfo/Kconfig"
#endif /* CONFIG_PRODUCT_REALME_SDM710 */

#ifdef CONFIG_PRODUCT_REALME_SDM710
#//Wen.Luo@BSP
source "drivers/soc/oppo/oppo_shutdown_detect/Kconfig"
#endif /* CONFIG_PRODUCT_REALME_SDM710 */

#Kun.Hu@TECH.BSP.Stability.PHOENIX_PROJECT 2019/06/15, Add for PHOENIX_PROJECT
#source "drivers/soc/oppo/oppo_phoenix/Kconfig"

#ifdef CONFIG_PRODUCT_REALME_SDM710
#GaoTing.Gan@PSW.MultiMedia.MediaServer, 2019/03/07, Add for kevent feedback
source "drivers/soc/oppo/oppo_kevent_feedback/Kconfig"
#endif /* CONFIG_PRODUCT_REALME_SDM710 */
```

## drivers/soc/oppo/oppo_devinfo/Kconfig
```kconfig
if PRODUCT_REALME_RMX1901
      config OPPO_DEVICE_IFNO
      bool "config oppo devinfo software"
	  help
		define this config to compile devinfo.c for device register
endif
```

## drivers/soc/oppo/oppo_healthinfo/Kconfig
```kconfig
#ifdef CONFIG_PRODUCT_REALME_SDM710
#//wenbin.liu@PSW.Kernel.MM, 2018/05/23, Add for Healthinfo monitor
config OPPO_HEALTHINFO
bool "config oppo healthinfo"
help
    define this config to init oppo healthinfo.
#endif /* CONFIG_PRODUCT_REALME_SDM710 */
```

## drivers/soc/oppo/oppo_kevent_feedback/Kconfig
```kconfig
#ifdef CONFIG_PRODUCT_REALME_SDM710
#//GaoTing.Gan@PSW.MultiMedia.MediaServer, 2019/03/07, Add for kevent feedback
config OPPO_CRITICALLOG
bool "config oppo kevent feedback"
help
    define this config to init oppo kevent feedback driver.
#endif /* CONFIG_PRODUCT_REALME_SDM710 */
```

## drivers/soc/oppo/oppo_mdmrst/Kconfig
```kconfig
# ifdef CONFIG_PRODUCT_REALME_SDM710
# yixue.ge add for config oppo software common soft
config RECORD_MDMRST
bool "config record mdmrst"
help
    define this config to count the modem restart times.
#endif /* CONFIG_PRODUCT_REALME_SDM710 */
```

## drivers/soc/oppo/oppo_shutdown_detect/Kconfig
```kconfig
#ifdef CONFIG_PRODUCT_REALME_SDM710
#Wen.Luo@PSW.Kernel.Stability, 2018/05/23, Add for oppo_shutdown_detect monitor
config OPPO_SHUTDOWN_DETECT
	bool "OPPO shutdown hang detect"
	default y
	help
	  define this config to init oppo oppo_shutdown_detect.
#endif /* CONFIG_PRODUCT_REALME_SDM710 */
```

## drivers/soc/oppo/oppo_trace/Kconfig
```kconfig
# ifdef CONFIG_PRODUCT_REALME_SDM710
# yixue.ge add for config oppo software common soft
      config OPPO_DEBUG_ASSERT
      bool "config oppo common software"
	  help
		define this config to get project verion from sharemem.
		Maybe this value is from CDT or dynamic identify by hardware
		id.
#endif /* CONFIG_PRODUCT_REALME_SDM710 */
```

## kernel/Kconfig.freezer
```kconfig
config FREEZER
	def_bool PM_SLEEP || CGROUP_FREEZER

config ELSA_STUB
	bool "Enable ELSA stub in kernel"
	default n
```
