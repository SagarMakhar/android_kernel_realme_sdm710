#include "pm660l-overlay.dtsi"
//#include "pm660-overlay.dtsi"
//#include "sdm670-audio-overlay-RMX1901.dtsi"
#include "sdm670-camera-sensor-mtp-overlay.dtsi"
#include "sdm670-ion-overlay.dtsi"
//#include "sdm670-mtp-overlay.dtsi"
#include "sdm670-overlay.dtsi"
#include "sdm670-pinctrl-overlay.dtsi"
#include "sdm670-pmic-overlay-RMX1901.dtsi"
#include "sdm670-qupv3-overlay.dtsi"
#include "sdm670-regulator-overlay.dtsi"
#include "sdm670-sde-display-overlay.dtsi"
#include "sdm710-overlay.dtsi"
